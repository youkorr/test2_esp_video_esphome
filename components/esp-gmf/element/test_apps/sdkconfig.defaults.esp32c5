## components/esp-gmf/element/test_apps/sdkconfig.defaults.esp32c5
```kconfig
CONFIG_ESPTOOLPY_FLASHFREQ_80M=y
CONFIG_ESPTOOLPY_FLASHFREQ_80M_DEFAULT=y
CONFIG_ESPTOOLPY_FLASHFREQ="80m"
CONFIG_ESPTOOLPY_FLASHSIZE_8MB=y
CONFIG_ESPTOOLPY_FLASHSIZE="8MB"

CONFIG_ESPTOOLPY_FLASHMODE_DIO=y
CONFIG_ESPTOOLPY_FLASHMODE="dio"

#
# Partition Table
#
CONFIG_PARTITION_TABLE_CUSTOM=y
CONFIG_PARTITION_TABLE_CUSTOM_FILENAME="partitions_8m.csv"
CONFIG_PARTITION_TABLE_FILENAME="partitions_8m.csv"
CONFIG_PARTITION_TABLE_OFFSET=0x8000
CONFIG_PARTITION_TABLE_MD5=y
# end of Partition Table

#
# ESP Speech Recognition
#
CONFIG_AFE_INTERFACE_V1=y
CONFIG_SR_NSN_WEBRTC=y
CONFIG_SR_VADN_WEBRTC=y

#
# Load Multiple Wake Words
#
CONFIG_SR_WN_WN9S_HILEXIN=y
# CONFIG_SR_WN_WN9S_HIESP is not set
# CONFIG_SR_WN_WN9S_NIHAOXIAOZHI is not set
# CONFIG_SR_WN_WN9S_HIJASON is not set
# end of Load Multiple Wake Words

CONFIG_SR_MN_CN_NONE=y
CONFIG_SR_MN_EN_NONE=y
# end of ESP Speech Recognition

CONFIG_GMF_AI_AUDIO_INIT_WN=y

CONFIG_ESP_CONSOLE_USB_SERIAL_JTAG=y
```

## components/human_face_recognition/Kconfig
```kconfig
menu "models: human_face_recognition"
    config HUMAN_FACE_RECOGNITION_MFN_S8_V1
        bool "Enable MFN (MobileFaceNet) S8 V1 model"
        default y
        help
            Enable the MobileFaceNet S8 V1 model for face recognition

    choice HUMAN_FACE_RECOGNITION_MODEL_TYPE
        prompt "Human face recognition model type"
        default HUMAN_FACE_RECOGNITION_MODEL_TYPE_MFN_S8_V1
        help
            Select the human face recognition model type

        config HUMAN_FACE_RECOGNITION_MODEL_TYPE_MFN_S8_V1
            bool "MFN_S8_V1"
            depends on HUMAN_FACE_RECOGNITION_MFN_S8_V1

        config HUMAN_FACE_RECOGNITION_MODEL_TYPE_MBF_S8_V1
            bool "MBF_S8_V1"
            depends on HUMAN_FACE_RECOGNITION_MFN_S8_V1
    endchoice

    config HUMAN_FACE_RECOGNITION_MODEL_TYPE
        int
        default 0 if HUMAN_FACE_RECOGNITION_MODEL_TYPE_MFN_S8_V1
        default 1 if HUMAN_FACE_RECOGNITION_MODEL_TYPE_MBF_S8_V1

    choice HUMAN_FACE_RECOGNITION_MODEL_LOCATION
        prompt "Human face recognition model location"
        default HUMAN_FACE_RECOGNITION_MODEL_IN_FLASH_RODATA
        help
            Select where the model is stored

        config HUMAN_FACE_RECOGNITION_MODEL_IN_FLASH_RODATA
            bool "Embed in flash (RODATA)"

        config HUMAN_FACE_RECOGNITION_MODEL_IN_FLASH_PARTITION
            bool "Flash partition"

        config HUMAN_FACE_RECOGNITION_MODEL_IN_SDCARD
            bool "SD card"
    endchoice

    config HUMAN_FACE_RECOGNITION_MODEL_LOCATION
        int
        default 0 if HUMAN_FACE_RECOGNITION_MODEL_IN_FLASH_RODATA
        default 1 if HUMAN_FACE_RECOGNITION_MODEL_IN_FLASH_PARTITION
        default 2 if HUMAN_FACE_RECOGNITION_MODEL_IN_SDCARD

    config HUMAN_FACE_RECOGNITION_MODEL_SDCARD_DIR
        string "SD card model directory"
        default "/sdcard/models/p4"
        depends on HUMAN_FACE_RECOGNITION_MODEL_IN_SDCARD
        help
            Path to models on SD card
endmenu
```
